## Kconfig
```kconfig
# Local Kconfig overrides for this zmk-config.
#
# This repo doubles as a Zephyr module (see zephyr/module.yml) purely so this
# file is sourced into the global Kconfig tree at build time, BEFORE ZMK's
# application Kconfig. That lets a `default` here win the default-precedence
# race against ZMK's own default.
#
# --- nice!view bottom-of-screen rendering fix (ZMK issue #3219) -------------
# On Zephyr 4.1 / LVGL 9.3, ZMK's built-in status screen needs more LVGL heap
# than the stock default of 4096 bytes; below that, glyphs at the bottom of
# the nice!view render as garbage/blocks. ZMK sets, in app/src/display/Kconfig:
#
#     config LV_Z_MEM_POOL_SIZE
#         default 4096 if ZMK_DISPLAY_STATUS_SCREEN_BUILT_IN
#
# That symbol is PROMPTLESS, so `CONFIG_LV_Z_MEM_POOL_SIZE=8192` in config/
# corne.conf is silently ignored (Zephyr ignores assignments to hidden
# symbols). Overriding the default from a module-sourced Kconfig is the
# supported way to actually change it.

config LV_Z_MEM_POOL_SIZE
	default 8192 if ZMK_DISPLAY_STATUS_SCREEN_BUILT_IN
```

## config/west.yml
```yaml
manifest:
  remotes:
    - name: zmkfirmware
      url-base: https://github.com/zmkfirmware
  projects:
    - name: zmk
      remote: zmkfirmware
      # Pinned to the v0.3 release (Zephyr 3.5). Tracking `main` pulled the
      # Zephyr 4.1 regression where the nice!view central half fails to wake
      # from deep sleep and drains the battery (ZMK issue #3207). v0.3 also
      # predates the #3219 nice!view rendering regression.
      revision: v0.3
      import: app/west.yml
  self:
    path: config
```
